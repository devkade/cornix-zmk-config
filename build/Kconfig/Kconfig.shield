## build/Kconfig/Kconfig.shield
```kconfig
osource "/Users/kade/Areas/cornix-zmk-config/zmk-keyboard-cornix/boards/shields/*/Kconfig.shield"
osource "/Users/kade/Areas/cornix-zmk-config/zmk/app/boards/shields/*/Kconfig.shield"
```

## build/right/Kconfig/Kconfig.shield.defconfig
```kconfig
osource "/Users/kade/Areas/cornix-zmk-config/zmk-keyboard-cornix/boards/shields/*/Kconfig.defconfig"
osource "/Users/kade/Areas/cornix-zmk-config/zmk/app/boards/shields/*/Kconfig.defconfig"
```
